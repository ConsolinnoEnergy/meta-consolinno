## conf/distro/1u0022-core.conf
```bitbake
## --*- bitbake -*--

require conf/distro/include/1u0022-common.inc

DISTRO_FEATURES:append = " initrd"

GLIBC_GENERATE_LOCALES = "en_GB.UTF-8 en_US.UTF-8 de_DE.UTF-8"
IMAGE_LINGUAS = "en-gb en-us de-de"

SANITY_TESTED_DISTROS:append = " fedora-39"

# we do not use package management on the target; no need to detect
# backwards going versions
ERROR_QA:remove = "version-going-backwards"
```

## conf/distro/1u0022-rauc-docker.conf
```bitbake
## --*- bitbake -*--

require conf/distro/1u0022-core.conf

DISTRO_FEATURES:append = " rauc virtualization"
```

## conf/distro/include/1u0022-common.inc
```bitbake
## --*- bitbake -*--

TCLIBCAPPEND = ""
DISTRO_VERSION = "0.0"
DISTRO_NAME = "consolinno leaflet distro"

### core distro settings

INIT_MANAGER = "systemd"

DISTRO_FEATURES_DEFAULT:append = " usrmerge tpm2 virtualization"
DISTRO_FEATURES_DEFAULT:remove = "alsa bluetooth irda nfc pcmcia pci zeroconf 3g x11 ext2 nfs vfat"
DISTRO_FEATURES_BACKFILL_CONSIDERED = "pulseaudio bluez5 sysvinit"

### static uid/gid

USERADD_GID_TABLES += "files/groups-static A"
USERADD_UID_TABLES += "files/passwd-static"
USERADD_ERROR_DYNAMIC = "skip"

USERADDEXTENSION = "useradd-staticids"

### security/ca setup

L1U0022_CA_PATH       ??= "~/.local/share/1u0022-ca"

## NOTE: this variable must not be expanded within "fakeroot" python fragments!
_L1U0022_CA_PATH_EXPANDED = "${@os.path.expanduser(d.getVar('L1U0022_CA_PATH'))}"

#### rauc

L1U0022_RAUC_CA_PATH  ??= "${_L1U0022_CA_PATH_EXPANDED}/rauc"
L1U0022_RAUC_KEY_FILE ??= "${L1U0022_RAUC_CA_PATH}/rauc.key"
L1U0022_RAUC_CRT_FILE ??= "${L1U0022_RAUC_CA_PATH}/rauc.crt"

## overrides the weak default in rauc-target.inc
RAUC_KEYRING_URI   ?= "file://${L1U0022_RAUC_CRT_FILE}"

#### image

L1U0022_IMAGE_CA_PATH  ??= "${_L1U0022_CA_PATH_EXPANDED}/image"
L1U0022_IMAGE_KEY_FILE ??= "${L1U0022_IMAGE_CA_PATH}/image.key"
L1U0022_IMAGE_CRT_FILE ??= "${L1U0022_IMAGE_CA_PATH}/image.crt"

L1U0022_IMAGE_KEY_HINT ??= "l1u0022-signing-key"

#### HAB

L1U0022_HAB_CA_PATH    ??= "${_L1U0022_CA_PATH_EXPANDED}/hab"
L1U0022_HAB_CA_PATH[doc] = "\
    Base directory of HAB CA; beside the entries listed below a file \
    with an hardcoded name 'key_pass.txt' is expected there. \
"

L1U0022_HAB_SRK_INDEX  ??= "0"
L1U0022_HAB_TABLE_BIN  ??= "${L1U0022_HAB_CA_PATH}/SRK.table.bin"

L1U0022_HAB_CSF_BASE   ??= "${L1U0022_HAB_CA_PATH}/CSF.pem"
L1U0022_HAB_CSF_BASE[doc] = "\
    CSF certificate; when ending in '_crt.pem' another file with a \
    '_key.pem' suffix is expected which contains the corresponding \
    private key\
"

L1U0022_HAB_IMG_BASE   ??= "${L1U0022_HAB_CA_PATH}/IMG.pem"
L1U0022_HAB_IMG_BASE[doc] = "\
    IMG certificate; when ending in '_crt.pem' another file with a \
    '_key.pem' suffix is expected which contains the corresponding \
    private key\
"

### misc settings
ROOT_HOME = "/root"
```

## conf/layer.conf
```bitbake
# We have a conf and classes directory, add to BBPATH
BBPATH:prepend = "${LAYERDIR}:"

# We have recipes-* directories, add to BBFILES
BBFILES += "\
    ${LAYERDIR}/recipes-*/*/*.bb \
    ${LAYERDIR}/recipes-*/*/*.bbappend \
"

BBFILES_DYNAMIC += " \
    rauc:${LAYERDIR}/dynamic-layers/rauc-layer/*/*/*.bbappend \
    rauc:${LAYERDIR}/dynamic-layers/rauc-layer/*/*/*.bb \
"

BBFILE_COLLECTIONS += "de.consolinno.1u0022.core"
BBFILE_PATTERN_de.consolinno.1u0022.core = "^${LAYERDIR}/"
BBFILE_PRIORITY_de.consolinno.1u0022.core = "30"
LAYERSERIES_COMPAT_de.consolinno.1u0022.core = "kirkstone"

LAYERDIR_de.consolinno.1u0022.core := "${LAYERDIR}"

LAYERDEPENDS_de.consolinno.1u0022.core = ""
```

## conf/machine/consolinno-leaflet-1u0022-1.conf
```bitbake
## --*- bitbake -*--
#@TYPE: Machine
#@NAME: consolinno-leaflet-1u0022-1
#@DESCRIPTION: Consolinno Leaflet 1u0022 i.MX6 ULL, 512MB RAM, eMMC
#@ARTICLENUMBERS: PB-02013-410I.A0, PCL-063-20910CI.A0

SOC_FAMILY = "imx:mx6:mx6ull"
require conf/machine/include/soc-family.inc

# Common settings for phytecs imx6ul boards
DEFAULTTUNE = "cortexa9thf-neon"
require conf/machine/include/arm/armv7a/tune-cortexa9.inc

# Sub-architecture support
MACHINE_SOCARCH = "${TUNE_PKGARCH}-mx6ull"
PACKAGE_EXTRA_ARCHS:append = " ${MACHINE_SOCARCH}"

KERNEL_DEVICETREE = ""
PREFERRED_PROVIDER_virtual/kernel = "kernel-1u0022"
PREFERRED_PROVIDER_virtual/bootloader ?= "barebox-1u0022"

PREFERRED_VERSION_kernel-1u0022 = "5.4+%"
PREFERRED_VERSION_barebox-1u0022 = "2024.01+%"

MACHINE_FEATURES = "usbhost vfat mmc serial spi i2c usbhost ext2 ext4 lvm2 fitimage initrd tpm"

SERIAL_CONSOLES = "115200;ttymxc1"

MACHINE_FIRMWARE_PROVIDER = "\
    linux-firmware-imx-sdma-imx6q \
"

MACHINE_DTBS = "\
    ${MACHINE}.dtb \
"
```

## recipes-core/fitimage/files/fitimage.its
```
// --*- dtree -*--

/dts-v1/;

/ {
	#address-cells = <1>;
	description = "${DISTRO_NAME} ${DISTRO_VERSION} (${MACHINE})";

	images: images {
		kernel {
			data = /incbin/("${DEPLOY_DIR_IMAGE}/zImage");
			description = "kernel";
			arch = "arm";
			type = "kernel";
			os = "linux";

			hash-1 {
				algo = "sha256";
			};
		};
	};

	configurations {
		default = "standard";
                cfg0: standard {
                        description = "Standard Boot";
                        kernel = "kernel";
                        fdt = "fdt-0x00000000";
                        ramdisk = "ramdisk-0x00000000";
                        hash {
                                algo = "sha256";
                        };
                };
	};
};
```
